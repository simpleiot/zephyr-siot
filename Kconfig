## apps/common/snmp/Kconfig.snmp
```kconfig
module = SNMP
module-str = snmp
source "subsys/logging/Kconfig.template.log_config"
```

## apps/siot-can-node/defconfig
```kconfig
CONFIG_GPIO=y
CONFIG_CONSOLE=y
CONFIG_THREAD_RUNTIME_STATS=y
CONFIG_UART_CONSOLE=y
CONFIG_SERIAL=y
CONFIG_USB_DEVICE_DRIVER=y
CONFIG_USB_DEVICE_STACK=y
CONFIG_USB_CDC_ACM=y
CONFIG_USB_DEVICE_INITIALIZE_AT_BOOT=y
```

## apps/siot-serial/defconfig
```kconfig
CONFIG_NET_L2_ETHERNET=y
# CONFIG_NET_IPV6 is not set
CONFIG_MAIN_STACK_SIZE=2048
CONFIG_GPIO=y
CONFIG_CONSOLE=y
CONFIG_THREAD_RUNTIME_STATS=y
CONFIG_UART_CONSOLE=y
CONFIG_DAC=y
CONFIG_DAC_SHELL=y
CONFIG_LOG_CMDS=y
# CONFIG_LOG_MEM_UTILIZATION is not set
```

## apps/siot/defconfig
```kconfig
CONFIG_NET_L2_ETHERNET=y
# CONFIG_NET_IPV6 is not set
CONFIG_MAIN_STACK_SIZE=2048
CONFIG_GPIO=y
CONFIG_CONSOLE=y
CONFIG_UART_CONSOLE=y
CONFIG_NETWORKING=y
CONFIG_NET_IPV4=y
CONFIG_NET_SHELL=y
CONFIG_NET_LOG=y
CONFIG_DNS_RESOLVER=y
CONFIG_DNS_SERVER_IP_ADDRESSES=y
CONFIG_DNS_SERVER1="8.8.8.8"
CONFIG_NET_CONFIG_SETTINGS=y
CONFIG_NET_DHCPV4=y
```

## boards/esp32_poe_wrover/esp32_poe_wrover_procpu_defconfig
```kconfig
# Copyright (c) 2023 Espressif Systems (Shanghai) Co., Ltd.
# SPDX-License-Identifier: Apache-2.0

CONFIG_MAIN_STACK_SIZE=2048

CONFIG_CONSOLE=y
CONFIG_SERIAL=y
CONFIG_UART_CONSOLE=y

CONFIG_GPIO=y

# PSRAM
CONFIG_ESP_SPIRAM=y
CONFIG_SPIRAM_MODE_OCT=y
CONFIG_SPIRAM_SPEED_80M=y
CONFIG_ESP32S3_DATA_CACHE_64KB=y
CONFIG_ESP_SPIRAM_MEMTEST=y

# Shell support
CONFIG_SHELL=y
CONFIG_SHELL_BACKEND_SERIAL=y

# SD card support (native SDMMC controller)
CONFIG_SDHC=y
CONFIG_DISK_DRIVERS=y
CONFIG_DISK_DRIVER_SDMMC=y

# SD/MMC debugging
CONFIG_SDHC_LOG_LEVEL_DBG=y
CONFIG_DISK_LOG_LEVEL_DBG=y
CONFIG_SD_LOG_LEVEL_DBG=y

# File system support
CONFIG_FILE_SYSTEM=y
CONFIG_FILE_SYSTEM_SHELL=y
CONFIG_FILE_SYSTEM_SHELL_MOUNT_COMMAND=y
CONFIG_FS_LOG_LEVEL_DBG=y

# Heap required for mount command
CONFIG_HEAP_MEM_POOL_SIZE=16384

# FAT filesystem (ELM implementation)
CONFIG_FAT_FILESYSTEM_ELM=y
CONFIG_FS_FATFS_LFN=y
CONFIG_FS_FATFS_LFN_MODE_STACK=y
CONFIG_FS_FATFS_MAX_LFN=255
CONFIG_FS_FATFS_MOUNT_MKFS=y
```

## boards/fysetc_ucan/Kconfig.fysetc_ucan
```kconfig
# Copyright (c) 2017 Clage GmbH
# SPDX-License-Identifier: Apache-2.0

config BOARD_FYSETC_UCAN
	select SOC_STM32F072XB
```

## tests/testcase.yaml
```yaml
tests:
  point_tests.test_test:
    platform_allow: native_posix
    tags: point
```
