## CMakeLists.txt
```
# SPDX-License-Identifier: Apache-2.0

cmake_minimum_required(VERSION 3.21)

find_package(Zephyr HINTS $ENV{ZEPHYR_BASE})
project(siot-nrf-simple)

# If board is nRF9160 add the source files 
target_sources(app PRIVATE src/main.c)
```

## prj.conf
```kconfig
CONFIG_GPIO=y

# Networking
CONFIG_NET_IPV6=n
CONFIG_NET_IPV4=y
CONFIG_NETWORKING=y
CONFIG_NET_SOCKETS=y
CONFIG_NET_SOCKETS_OFFLOAD=y
CONFIG_NET_CONNECTION_MANAGER=y
CONFIG_NET_UDP=y
CONFIG_NET_TCP=y

# net shell
CONFIG_SHELL=y
CONFIG_AT_SHELL=y
CONFIG_NET_SHELL=y

# LTE link control
CONFIG_LTE_LINK_CONTROL=y
CONFIG_LTE_NETWORK_MODE_LTE_M_GPS=y

# PSM enablez (LTE_LC_PSM_MODULE gates the PSM submodule in NCS v3.x)
CONFIG_LTE_LC_PSM_MODULE=y
CONFIG_LTE_PSM_REQ=y
CONFIG_LTE_PSM_REQ_RPTAU="00100110" # 6 hour
CONFIG_LTE_PSM_REQ_RAT="00000011" # 6 sec active time

# Modem library
CONFIG_NRF_MODEM_LIB=y
CONFIG_NRF_MODEM_LIB_TRACE=n
CONFIG_MODEM_KEY_MGMT=y
```

## src/main.c
```c
#include <zephyr/kernel.h>
#include <zephyr/devicetree.h>
#include <zephyr/drivers/led.h>
#include <zephyr/logging/log.h>

LOG_MODULE_REGISTER(main);

/* nRF Libraries */
#include <modem/lte_lc.h>
#include <modem/modem_info.h>
#include <modem/nrf_modem_lib.h>

static const struct device *leds = DEVICE_DT_GET(DT_NODELABEL(npm1300_leds));

int main(void)
{
	LOG_INF("SIOT nRF Simple");

	LOG_INF("HTTPS Sample. Board: %s", CONFIG_BOARD);

	/* Init modem lib */
	int err = nrf_modem_lib_init();
	if (err < 0) {
		LOG_ERR("Failed to init modem lib. (err: %i)", err);
		return err;
	}

	/* Power saving is turned on (lte_lc_init was removed in NCS v3.x —
	 * lte_lc_connect now performs initialization internally). */
	lte_lc_psm_req(true);

	/* Connect */
	err = lte_lc_connect();
	if (err < 0) {
		LOG_ERR("Failed to connect. Err: %i", err);
		return err;
	}

	while (1) {
		led_on(leds, 2U);
		k_sleep(K_MSEC(500));
		led_off(leds, 2U);
		k_sleep(K_MSEC(500));
	}

	return 0;
}
```
