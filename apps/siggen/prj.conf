## CMakeLists.txt
```
# SPDX-License-Identifier: Apache-2.0

cmake_minimum_required(VERSION 3.20.0)

find_package(Zephyr REQUIRED HINTS $ENV{ZEPHYR_BASE})
project(siggen)

target_sources(app PRIVATE src/main.c)
```

## sample.yaml
```
sample:
  description: SIOT signal generator
  name: SIOT
common:
  tags: introduction
  integration_platforms:
    - native_sim
  harness: console
  harness_config:
    type: one_line
    regex:
      - "Hello World! (.*)"
tests:
  sample.basic.helloworld:
    tags: introduction
```

## prj.conf
```kconfig
CONFIG_SHELL=y

CONFIG_DAC=y
CONFIG_DAC_SHELL=y

CONFIG_LOG=y
CONFIG_LOG_CMDS=y
```

## boards/nucleo_h743zi.conf
```kconfig
CONFIG_NETWORKING=y
CONFIG_NET_L2_ETHERNET=y

CONFIG_NET_IPV6=n
CONFIG_NET_IPV4=y
CONFIG_NET_DHCPV4=y

CONFIG_NET_LOG=y
CONFIG_NET_SHELL=y
CONFIG_NET_CONFIG_SETTINGS=y

CONFIG_DNS_RESOLVER=y
CONFIG_DNS_SERVER_IP_ADDRESSES=y
CONFIG_DNS_SERVER1="8.8.8.8"

# HTTP Server stuff
CONFIG_HTTP_SERVER=y
#CONFIG_HTTP_SERVER_WEBSOCKET=y
CONFIG_HTTP_SERVER_RESOURCE_WILDCARD=y
CONFIG_NET_HTTP_SERVER_LOG_LEVEL_DBG=y
CONFIG_EVENTFD=y
CONFIG_ZVFS_EVENTFD_MAX=10
CONFIG_EVENTFD_MAX=5
```

## boards/nucleo_h743zi.overlay
```dts
// / {
//     zephyr,user {
//         /* Define a label for the DAC output pin */
//         dac-out-1 = <&dac1_out1>;
//     };
// };

&dac1 {
    status = "okay";
    pinctrl-0 = <&dac1_out1_pa4>;
    pinctrl-names = "default";
    #io-channel-cells = <1>;
};

&pinctrl {
    dac1_out1_pa4: dac1_out1_pa4 {
        pinmux = <STM32_PINMUX('A', 4, ANALOG)>;
    };
};
```

## boards/nucleo_l432kc.overlay
```dts
&dac1 {
    status = "okay";
    pinctrl-0 = <&dac1_out1_pa4>;
    pinctrl-names = "default";
    #io-channel-cells = <1>;
};

&pinctrl {
    dac1_out1_pa4: dac1_out1_pa4 {
        pinmux = <STM32_PINMUX('A', 4, ANALOG)>;
    };
};
```

## src/main.c
```c
#include <zephyr/net/http/server.h>
#include <zephyr/net/http/service.h>
#include <zephyr/logging/log.h>
#include <zephyr/drivers/dac.h>

LOG_MODULE_REGISTER(siot, LOG_LEVEL_DBG);

// HTTP_RESOURCE_DEFINE(ws_resource, test_http_service, "/", &ws_resource_detail);

// static uint16_t https_service_port = 80;
// HTTPS_SERVICE_DEFINE(siot_https_service, CONFIG_NET_CONFIG_MY_IPV4_ADDR,
// 		     &https_service_port, 1, 10, NULL,
// 		     sec_tag_list_verify_none, sizeof(sec_tag_list_verify_none));

#define DAC_DEVICE_NODE DT_NODELABEL(dac1)

// The DAC works on the L432KC, but the user shell does not

void gen_triangle(const struct device *dac_dev, int chan)
{
	const int min = 0;
	const int max = 1241; // 1V
	bool up = true;
	int value = 0;
	const int delay = 110;

	LOG_DBG("Delay is %i: ", delay);

	while (1) {
		if (up) {
			value++;
			if (value >= max) {
				up = false;
			}
		} else {
			value--;
			if (value <= min) {
				up = true;
			}
		}
		int ret = dac_write_value(dac_dev, chan, value);
		if (ret != 0) {
			LOG_ERR("Error writing to DAC: %i", ret);
		}
		k_msleep(delay);
	}
}

int main(void)
{
	LOG_INF("SIOT Zephyr Signal Generator! %s", CONFIG_BOARD_TARGET);
	// http_server_start();

	const struct device *dac_dev = DEVICE_DT_GET(DAC_DEVICE_NODE);

	if (!device_is_ready(dac_dev)) {
		LOG_WRN("DAC device not ready\n");
	}

	const int chan = 1;

	struct dac_channel_cfg dac_cfg = {.channel_id = chan, .resolution = 12};

	if (dac_channel_setup(dac_dev, &dac_cfg) != 0) {
		LOG_ERR("DAC channel setup failed\n");
	}

	gen_triangle(dac_dev, chan);

	return 0;
}
```
