## CMakeLists.txt
```
# SPDX-License-Identifier: Apache-2.0

cmake_minimum_required(VERSION 3.20.0)

find_package(Zephyr REQUIRED HINTS $ENV{ZEPHYR_BASE})
project(siot)

zephyr_include_directories(${CMAKE_CURRENT_SOURCE_DIR}/../common)

target_sources(app PRIVATE 
	src/main.c 
	src/web.c
)

set(gen_dir ${ZEPHYR_BINARY_DIR}/include/generated/)

foreach(web_resource index.html index.js)
	generate_inc_file_for_target(
		app
		frontend/dist/${web_resource}
		${gen_dir}/${web_resource}.gz.inc
		--gzip
	)
endforeach()

zephyr_linker_sources(SECTIONS sections-rom.ld)

zephyr_linker_section_ifdef(CONFIG_NET_SAMPLE_HTTP_SERVICE NAME
				http_resource_desc_test_http_service
				KVMA RAM_REGION GROUP RODATA_REGION
				SUBALIGN Z_LINK_ITERABLE_SUBALIGN)
```

## prj.conf
```kconfig
CONFIG_SHELL=y
CONFIG_I2C=y
CONFIG_I2C_SHELL=y


CONFIG_NETWORKING=y
CONFIG_NET_L2_ETHERNET=y

CONFIG_NET_IPV6=n
CONFIG_NET_IPV4=y
CONFIG_NET_DHCPV4=y
CONFIG_NET_SOCKETS=y
CONFIG_NET_TCP=y
CONFIG_NET_CONNECTION_MANAGER=y
CONFIG_NET_LOG=y
CONFIG_NET_SHELL=y
CONFIG_NET_CONFIG_SETTINGS=y

CONFIG_DNS_RESOLVER=y
CONFIG_DNS_SERVER_IP_ADDRESSES=y
CONFIG_DNS_SERVER1="8.8.8.8"

# HTTP Server stuff
CONFIG_HTTP_SERVER=y
#CONFIG_HTTP_SERVER_WEBSOCKET=y
CONFIG_HTTP_SERVER_RESOURCE_WILDCARD=y
#CONFIG_NET_HTTP_SERVER_LOG_LEVEL_DBG=y
CONFIG_EVENTFD=y
CONFIG_ZVFS_EVENTFD_MAX=10
# CONFIG_EVENTFD_MAX=5
CONFIG_INIT_STACKS=y
CONFIG_ZVFS_OPEN_MAX=46
CONFIG_POSIX_API=y
# CONFIG_POSIX_CLOCK=y
CONFIG_POSIX_TIMERS=y
CONFIG_ZVFS_FDTABLE=y
CONFIG_NET_SOCKETS_POLL_MAX=16

CONFIG_HTTP_PARSER_URL=y
CONFIG_HTTP_PARSER=y
CONFIG_HTTP_SERVER=y
CONFIG_HTTP_SERVER_MAX_CLIENTS=6

# Network buffers
CONFIG_NET_PKT_RX_COUNT=32
CONFIG_NET_PKT_TX_COUNT=32
CONFIG_NET_BUF_RX_COUNT=128
CONFIG_NET_BUF_TX_COUNT=128
CONFIG_NET_CONTEXT_NET_PKT_POOL=y

# CONFIG_HTTP_SERVER_MAX_HEADER_LEN=256

# IP address options
CONFIG_NET_IF_UNICAST_IPV6_ADDR_COUNT=3
CONFIG_NET_IF_MCAST_IPV6_ADDR_COUNT=4
CONFIG_NET_MAX_CONTEXTS=32
CONFIG_NET_MAX_CONN=32

CONFIG_LOG=y
CONFIG_LOG_CMDS=y
CONFIG_THREAD_MONITOR=y
CONFIG_THREAD_RUNTIME_STATS=y
CONFIG_SCHED_THREAD_USAGE=y
CONFIG_SCHED_THREAD_USAGE_ANALYSIS=y
CONFIG_SCHED_THREAD_USAGE_ALL=y
CONFIG_SCHED_THREAD_USAGE_AUTO_ENABLE=y

# example external sample integration
CONFIG_LIBSAMPLE=y
# CONFIG_LIB_SNMP=y

CONFIG_ASSERT=y
CONFIG_ZBUS=y
CONFIG_ZBUS_RUNTIME_OBSERVERS=y
CONFIG_ZBUS_MSG_SUBSCRIBER=y
CONFIG_ZBUS_LOG_LEVEL_INF=y
CONFIG_ZBUS_CHANNEL_NAME=y
# Message subscriber buffers come from a fixed pool rather than the heap. Every
# publish to a channel with message subscribers allocates a buffer, and with the
# dynamic allocator that came out of the 2 KB zbus heap. At 80 bytes for a
# point, the heap held roughly 20 messages in flight regardless of the pool
# count, and once it was exhausted the allocation returned NULL, which zbus
# asserts on. A fixed pool makes the capacity what it says it is and takes the
# heap out of the publish path.
#
# STATIC_DATA_SIZE must be at least the largest message on any channel, which is
# sizeof(point) at 80 bytes. 96 leaves room for the struct to grow.
CONFIG_ZBUS_MSG_SUBSCRIBER_BUF_ALLOC_STATIC=y
CONFIG_ZBUS_MSG_SUBSCRIBER_NET_BUF_STATIC_DATA_SIZE=96
CONFIG_ZBUS_MSG_SUBSCRIBER_NET_BUF_POOL_SIZE=48

CONFIG_LIB_SIOT=y

CONFIG_REQUIRES_FLOAT_PRINTF=y


# Point cache and shell point streaming. The shell protocol lets a host
# running Simple IoT exchange points over the console UART, which on the
# Nucleo-H743ZI is the ST-LINK virtual COM port.
CONFIG_SIOT_POINT_CACHE=y
CONFIG_SIOT_POINT_SHELL=y
# The shell print buffer defaults to 30 bytes, which chunks every emitted
# point line into several UART flushes.
CONFIG_SHELL_PRINTF_BUFF_SIZE=128
```

## boards/esp32_ethernet_kit_procpu.conf
```kconfig
CONFIG_ETH_ESP32=y
```

## boards/esp32_poe_procpu.conf
```kconfig
CONFIG_ETH_ESP32=y

CONFIG_FLASH=y
CONFIG_REBOOT=y
CONFIG_MPU_ALLOW_FLASH_WRITE=y
CONFIG_ZMS_LOG_LEVEL_DBG=y
```

## boards/esp32_poe_wrover_procpu.conf
```kconfig
CONFIG_ETH_ESP32=y

CONFIG_FLASH=y
CONFIG_REBOOT=y
CONFIG_MPU_ALLOW_FLASH_WRITE=y
CONFIG_ZMS_LOG_LEVEL_DBG=y

# Shell support
CONFIG_SHELL=y
CONFIG_SHELL_BACKEND_SERIAL=y

# SD card support (native SDMMC controller)
CONFIG_SDHC=y
CONFIG_DISK_ACCESS=y
CONFIG_DISK_DRIVERS=y
CONFIG_DISK_DRIVER_SDMMC=y

# SD/MMC debugging
# CONFIG_SDHC_LOG_LEVEL_DBG=y
# CONFIG_DISK_LOG_LEVEL_DBG=y
# CONFIG_SD_LOG_LEVEL_DBG=y
# CONFIG_FS_LOG_LEVEL_DBG=y

# File system support
CONFIG_FILE_SYSTEM=y
CONFIG_FILE_SYSTEM_SHELL=y
CONFIG_FILE_SYSTEM_SHELL_MOUNT_COMMAND=y

# Heap required for mount command and k_malloc
CONFIG_HEAP_MEM_POOL_SIZE=16384

# FAT filesystem (ELM implementation)
CONFIG_FAT_FILESYSTEM_ELM=y
CONFIG_MAIN_STACK_SIZE=4096
CONFIG_FS_FATFS_LFN=y
CONFIG_FS_FATFS_LFN_MODE_STACK=y
CONFIG_FS_FATFS_MAX_LFN=255
CONFIG_FS_FATFS_MOUNT_MKFS=y
```

## boards/esp32_devkitc_wroom_procpu.overlay
```dts
&dac {
    status = "okay";
};

/ {
    zephyr,user {
        dac = <&dac>;
        dac-channel-id = <0>;  // Use 0 for GPIO25 (DAC1) or 1 for GPIO26 (DAC2)
        dac-resolution = <8>;  // ESP32 only supports 8-bit resolution
    };
};
```

## boards/esp32_poe_wrover_procpu.overlay
```dts
/*
 * Copyright (c) 2022 Grant Ramsay <grant.ramsay@hotmail.com>
 *
 * SPDX-License-Identifier: Apache-2.0
 */

&eth {
	status = "okay";
};

&phy {
	status = "okay";
};

&mdio {
	status = "okay";
};

// &dac {
//     status = "okay";
// };

// / {
//     zephyr,user {
//         dac = <&dac>;
//         dac-channel-id = <0>;  // Use 0 for GPIO25 (DAC1) or 1 for GPIO26 (DAC2)
//         dac-resolution = <8>;  // ESP32 only supports 8-bit resolution
//     };
// };
```

## boards/nucleo_h743zi.overlay
```dts
/*
 * STM32H743ZI flash repartition for siot-net.
 *
 * The STM32H743 has 128 KiB flash erase sectors. ZMS (lib/nvs.c) needs at
 * least 2 erase sectors, so the stock board `storage_partition` (128 KiB =
 * a single sector) is too small and point persistence is disabled there.
 *
 * The stock board layout only defines partitions through 0xE0000, leaving
 * the upper ~1.1 MiB of the 2 MiB flash unused. This overlay relocates
 * `storage_partition` into that unused region and grows it to 256 KiB
 * (2 x 128 KiB sectors) so ZMS can mount.
 *
 * mcuboot / slot0 / slot1 / scratch are left exactly as defined by the
 * board DTS. The application still runs from slot0 (zephyr,code-partition,
 * 0x40000), so app boot and the MCUboot image-slot layout are unchanged.
 * The old 0x20000 region is intentionally left as an unused gap.
 */

/delete-node/ &storage_partition;

&flash0 {
	partitions {
		/* storage: 256 KiB = 2 x 128 KiB erase sectors for ZMS */
		storage_partition: partition@e0000 {
			label = "storage";
			reg = <0x000e0000 DT_SIZE_K(256)>;
		};
	};
};
```

## src/main.c
```c
#include "zephyr/sys/util.h"
#include <nvs.h>
#include <point.h>

#include <zephyr/net/http/server.h>
#include <zephyr/net/net_mgmt.h>
#include <zephyr/logging/log.h>
#include <zephyr/zbus/zbus.h>
#include <sys/types.h>
#include <app_version.h>

#if defined(CONFIG_FAT_FILESYSTEM_ELM)
#include <zephyr/fs/fs.h>
#include <zephyr/storage/disk_access.h>
#include <ff.h>
#endif

LOG_MODULE_REGISTER(siot, LOG_LEVEL_DBG);

// The following points will get persisted in NVS when the show up on
// zbus point_chan.
static const struct nvs_point nvs_pts[] = {
	{1, &point_def_boot_count, "0"}, {2, &point_def_description, "0"},
	{3, &point_def_staticip, "0"},   {4, &point_def_address, "0"},
	{5, &point_def_gateway, "0"},    {6, &point_def_netmask, "0"},
};

// ==================================================
// Network manager

static struct net_mgmt_event_callback mgmt_cb;

static void net_event_handler(struct net_mgmt_event_callback *cb, uint64_t mgmt_event,
			      struct net_if *iface)
{
	if (mgmt_event == NET_EVENT_L4_CONNECTED) {
		LOG_INF("Network connected\n");
	}
}

// ==================================================
// SD Card

#if defined(CONFIG_FAT_FILESYSTEM_ELM)
static FATFS fat_fs;
static struct fs_mount_t mp = {
	.type = FS_FATFS,
	.fs_data = &fat_fs,
};

static void sd_card_init(void)
{
	static const char *disk_pdrv = "SD";
	static const char *disk_mount_pt = "/SD:";
	int ret;

	LOG_INF("CLIFF: sd_card_init");

	// Raw disk i/o - check if disk is present
	do {
		uint64_t memory_size_mb;
		uint32_t block_count;
		uint32_t block_size;

		if (disk_access_ioctl(disk_pdrv, DISK_IOCTL_CTRL_INIT, NULL) != 0) {
			LOG_ERR("Storage init ERROR!");
			break;
		}

		LOG_INF("SD card found");

		if (disk_access_ioctl(disk_pdrv, DISK_IOCTL_GET_SECTOR_COUNT, &block_count)) {
			LOG_ERR("Unable to get sector count");
			break;
		}
		LOG_INF("Block count %u", block_count);

		if (disk_access_ioctl(disk_pdrv, DISK_IOCTL_GET_SECTOR_SIZE, &block_size)) {
			LOG_ERR("Unable to get sector size");
			break;
		}
		LOG_INF("Sector size %u\n", block_size);

		memory_size_mb = (uint64_t)block_count * block_size;
		LOG_INF("Memory Size(MB) %u\n", (uint32_t)(memory_size_mb >> 20));

		if (disk_access_ioctl(disk_pdrv, DISK_IOCTL_CTRL_DEINIT, NULL) != 0) {
			LOG_ERR("Storage deinit ERROR!");
			break;
		}
	} while (0);

	mp.mnt_point = disk_mount_pt;

	ret = fs_mount(&mp);
	if (ret != 0) {
		LOG_ERR("Failed to mount SD card (err: %d)", ret);
		return;
	}

	LOG_INF("SD card mounted at %s", mp.mnt_point);

	// List files in root directory
	struct fs_dir_t dirp;
	struct fs_dirent entry;

	fs_dir_t_init(&dirp);
	ret = fs_opendir(&dirp, mp.mnt_point);
	if (ret != 0) {
		LOG_ERR("Failed to open SD card directory (err: %d)", ret);
		return;
	}

	LOG_INF("Contents of %s:", mp.mnt_point);
	while (1) {
		ret = fs_readdir(&dirp, &entry);
		if (ret != 0 || entry.name[0] == 0) {
			break;
		}

		if (entry.type == FS_DIR_ENTRY_DIR) {
			LOG_INF("  [DIR]  %s", entry.name);
		} else {
			LOG_INF("  [FILE] %s (size: %u bytes)", entry.name, entry.size);
		}
	}

	fs_closedir(&dirp);
}
#endif

// ********************************
// main

int main(void)
{
	LOG_INF("SIOT MCU: %s %s", CONFIG_BOARD_TARGET, APP_VERSION_EXTENDED_STRING);

	// Fix GPIO0 value so WROVER clock out works
	if (strcmp(CONFIG_BOARD_TARGET, "esp32_poe_wrover/esp32/procpu") == 0) {
		LOG_DBG("Fix up GPIO0 on wrover");
		(*(volatile uint32_t *)0x3FF49044) = 0x1900;
	}

	nvs_init(nvs_pts, ARRAY_SIZE(nvs_pts));

#if defined(CONFIG_FAT_FILESYSTEM_ELM)
	sd_card_init();
#endif

	// In your initialization code:
	net_mgmt_init_event_callback(&mgmt_cb, net_event_handler, NET_EVENT_L4_CONNECTED);
	net_mgmt_add_event_callback(&mgmt_cb);
}
```

## src/state.c
```c
#include "state.h"
#include "point.h"

#include <zephyr/kernel.h>
#include <zephyr/fs/nvs.h>
#include <zephyr/logging/log.h>
#include <zephyr/drivers/flash.h>
#include <zephyr/storage/flash_map.h>
#include <zephyr/zbus/zbus.h>

#define STACKSIZE 1024
#define PRIORITY  7

LOG_MODULE_REGISTER(siot_state, LOG_LEVEL_DBG);

ZBUS_CHAN_DECLARE(point_chan);

// ********************************
// NVS Config storage

// NVS Keys
#define NVS_KEY_BOOT_CNT    1
#define NVS_KEY_DESCRIPTION 2
#define NVS_KEY_STATIC_IP   3
#define NVS_KEY_IP_ADDR     4
#define NVS_KEY_GATEWAY     5
#define NVS_KEY_NETMASK     6

static struct nvs_fs fs;

#define NVS_PARTITION        storage_partition
#define NVS_PARTITION_DEVICE FIXED_PARTITION_DEVICE(NVS_PARTITION)
#define NVS_PARTITION_OFFSET FIXED_PARTITION_OFFSET(NVS_PARTITION)

// store saved settings in points here
static point state_points[10];

void nvs_dump_settings(point *points, size_t len)
{
	// TODO: extract settings from state
	// LOG_INF("Device ID: %s", config->device_id);

	// LOG_INF("Static IP enabled: %s", config->static_ip ? "yes" : "no");

	// LOG_INF("IP Address: %s", config->ip_addr);

	// LOG_INF("Subnet mask: %s", config->subnet_mask);

	// LOG_INF("Gateway: %s", config->gateway);
}

static char buf[30];

int nvs_init()
{
	struct flash_pages_info info;
	int rc = 0;

	/* define the nvs file system by settings with:
	 *	sector_size equal to the pagesize,
	 *	3 sectors
	 *	starting at NVS_PARTITION_OFFSET
	 */
	fs.flash_device = NVS_PARTITION_DEVICE;
	if (!device_is_ready(fs.flash_device)) {
		LOG_ERR("Flash device %s is not ready\n", fs.flash_device->name);
		return -1;
	}
	fs.offset = NVS_PARTITION_OFFSET;
	rc = flash_get_page_info_by_offs(fs.flash_device, fs.offset, &info);
	if (rc) {
		LOG_ERR("Unable to get page info\n");
		return -1;
	}
	fs.sector_size = info.size;
	fs.sector_count = 3U;

	rc = nvs_mount(&fs);
	if (rc) {
		LOG_ERR("Flash Init failed\n");
		return -1;
	}

	// rc = nvs_read(&fs, NVS_KEY_BOOT_CNT, &config.bootcount, sizeof(config.bootcount));
	// if (rc > 0) { /* item was found, show it */
	// 	LOG_INF("Boot count: %d\n", config.bootcount);
	// 	config.bootcount++;
	// 	(void)nvs_write(&fs, NVS_KEY_BOOT_CNT, &config.bootcount, sizeof(config.bootcount));
	// } else { /* item was not found, add it */
	// 	LOG_INF("No boot counter found, adding it at id %d\n", NVS_KEY_BOOT_CNT);
	// 	(void)nvs_write(&fs, NVS_KEY_BOOT_CNT, &config.bootcount, sizeof(config.bootcount));
	// }

	// rc = nvs_read(&fs, NVS_KEY_DESCRIPTION, &config.device_id, sizeof(config.device_id));
	// if (rc < 0) {
	// 	LOG_ERR("Error reading device id: %i", rc);
	// 	nvs_write(&fs, NVS_KEY_DESCRIPTION, "", sizeof(""));
	// }

	// nvs_read(&fs, NVS_KEY_STATIC_IP, &buf, sizeof(buf));
	// if (rc > 0) {
	// 	if (strcmp("true", buf)) {
	// 		config.static_ip = true;
	// 	} else {
	// 		config.static_ip = false;
	// 	}
	// }

	// nvs_read(&fs, NVS_KEY_IP_ADDR, &config.ip_addr, sizeof(config.ip_addr));
	// if (rc < 0) {
	// 	LOG_ERR("Error reading IP address: %i", rc);
	// 	nvs_write(&fs, NVS_KEY_IP_ADDR, "", sizeof(""));
	// }

	// nvs_read(&fs, NVS_KEY_NETMASK, &config.subnet_mask, sizeof(config.subnet_mask));
	// if (rc < 0) {
	// 	LOG_ERR("Error reading subnet mask: %i", rc);
	// 	nvs_write(&fs, NVS_KEY_NETMASK, "", sizeof(""));
	// }

	// nvs_read(&fs, NVS_KEY_GATEWAY, &config.gateway, sizeof(config.gateway));
	// if (rc < 0) {
	// 	LOG_ERR("Error reading gateway: %i", rc);
	// 	nvs_write(&fs, NVS_KEY_GATEWAY, "", sizeof(""));
	// }

	// nvs_dump_settings(&config);

	// zbus_chan_pub(&z_config_chan, &config, K_MSEC(500));

	return 0;
}

int point_type_key_to_nvs_id(char *type, char *key)
{
	if (strcmp(type, POINT_TYPE_DESCRIPTION) == 0) {
		return NVS_KEY_DESCRIPTION;
	} else if (strcmp(type, POINT_TYPE_STATICIP) == 0) {
		return NVS_KEY_STATIC_IP;
	} else if (strcmp(type, POINT_TYPE_ADDRESS) == 0) {
		return NVS_KEY_IP_ADDR;
	} else if (strcmp(type, POINT_TYPE_NETMASK) == 0) {
		return NVS_KEY_NETMASK;
	} else if (strcmp(type, POINT_TYPE_GATEWAY) == 0) {
		return NVS_KEY_GATEWAY;
	} else {
		return -1;
	}
}

void z_config_handle_point(point *p)
{

	int nvs_id = point_type_key_to_nvs_id(p->type, p->key);

	if (nvs_id < 0) {
		return;
	}

	int len = point_data_len(p);

	if (len <= 0) {
		LOG_DBG("Warning, received point with data len: %i", len);
	}

	ssize_t cnt = nvs_write(&fs, nvs_id, p->data, len);
	// 0 indicates value is already written and nothing to do
	if (cnt != 0 && (cnt < 0 || cnt != len)) {
		LOG_ERR("Error writing setting: %s, len: %i, written: %zu", p->type, len, cnt);
		return;
	}
}

ZBUS_MSG_SUBSCRIBER_DEFINE(state_sub);
ZBUS_CHAN_ADD_OBS(point_chan, state_sub, 3);

// For some reason the following does not work, so added a ZBUS_OBS_DECLARE in main.c
// ZBUS_CHAN_ADD_OBS(z_config_chan, z_config_sub, 3);

void state_thread(void *arg1, void *arg2, void *arg3)
{
	LOG_INF("z config thread");
	nvs_init();

	const struct zbus_channel *chan;
	point p;

	while (!zbus_sub_wait_msg(&state_sub, &chan, &p, K_FOREVER)) {
		if (chan == &point_chan) {
			char desc[40];
			point_dump(&p, desc, sizeof(desc));
			z_config_handle_point(&p);
		}
	}
}

K_THREAD_DEFINE(state, STACKSIZE, state_thread, NULL, NULL, NULL, PRIORITY, K_ESSENTIAL, 0);
```

## src/state.h
```c
#ifndef __STATE_H_
#define __STATE_H_

#include <stdint.h>
#include <stdbool.h>

typedef struct siot_state_t {
  uint32_t bootcount;
  char device_id[20];
  bool static_ip;
  char ip_addr[20];
  char subnet_mask[20];
  char gateway[20];
} z_mr_config;

#define SIOT_STATE_INIT { \
    .bootcount = 0, \
    .device_id = {0}, \
    .static_ip = false, \
    .ip_addr = {0}, \
    .subnet_mask = {0}, \
    .gateway = {0} \
}

#endif // __STATE_H_
```

## src/web.c
```c
#include <point.h>

#include <zephyr/data/json.h>
#include <zephyr/kvss/nvs.h>
#include <zephyr/kernel.h>
#include <zephyr/logging/log.h>
#include <zephyr/net/http/server.h>
#include <zephyr/net/http/service.h>
#include <zephyr/sys/util.h>
#include <zephyr/zbus/zbus.h>

#include <string.h>

#define STACKSIZE 1024
#define PRIORITY  7

LOG_MODULE_REGISTER(siot_web, LOG_LEVEL_DBG);

ZBUS_CHAN_DECLARE(point_chan);

// ==================================================
// State that is mirrored from other subsystems. A lock must be used
// when accessing these variables as they can be accessed in the web
// callbacks

K_MUTEX_DEFINE(web_points_lock);
static point web_points[40] = {};

// ==================================================
// HTTP Service

static uint8_t recv_buffer[2048];

static uint16_t http_service_port = 80;
HTTP_SERVICE_DEFINE(siot_http_service, "0.0.0.0", &http_service_port, 1, 10, NULL, NULL, NULL);

const static uint8_t index_html_gz[] = {
#include "index.html.gz.inc"
};

const static uint8_t index_js_gz[] = {
#include "index.js.gz.inc"
};

// ==================================================
// index.html resource

struct http_resource_detail_static index_html_gz_resource_detail = {
	.common =
		{
			.type = HTTP_RESOURCE_TYPE_STATIC,
			.bitmask_of_supported_http_methods = BIT(HTTP_GET),
			.content_encoding = "gzip",
			.content_type = "text/html",
		},
	.static_data = index_html_gz,
	.static_data_len = sizeof(index_html_gz),
};

HTTP_RESOURCE_DEFINE(index_html_gz_resource, siot_http_service, "/",
		     &index_html_gz_resource_detail);

struct http_resource_detail_static index_js_gz_resource_detail = {
	.common =
		{
			.type = HTTP_RESOURCE_TYPE_STATIC,
			.bitmask_of_supported_http_methods = BIT(HTTP_GET),
			.content_encoding = "gzip",
			.content_type = "application/javascript",
		},
	.static_data = index_js_gz,
	.static_data_len = sizeof(index_js_gz),
};

HTTP_RESOURCE_DEFINE(index_js_gz_resource, siot_http_service, "/index.js",
		     &index_js_gz_resource_detail);

// ********************************
// v1 API handler

// static const struct json_obj_descr point_descr[] = {
// 	JSON_OBJ_DESCR_FIELD(struct point_js_t, type, JSON_TOK_STRING),
// 	JSON_OBJ_DESCR_FIELD(point_js, key, JSON_TOK_STRING),
// };

static int v1_handler(struct http_client_ctx *client, enum http_transaction_status status,
		      const struct http_request_ctx *request_ctx, struct http_response_ctx *resp,
		      void *user_data)
{

	static uint8_t v1_payload_buf[256];
	static size_t cursor;

	if (client->method == HTTP_POST) {
		// Copy payload to our buffer. Note that even for a small payload, it
		// may arrive split into chunks (e.g. if the header size was such that
		// the whole HTTP request exceeds the size of the client buffer).
		if (request_ctx->data_len + cursor > sizeof(v1_payload_buf)) {
			cursor = 0;
			return -ENOMEM;
		}

		memcpy(v1_payload_buf + cursor, request_ctx->data, request_ctx->data_len);
		cursor += request_ctx->data_len;
	}

	if (status == HTTP_SERVER_TRANSACTION_ABORTED) {
		cursor = 0;
		return 0;
	}

	if (status == HTTP_SERVER_REQUEST_DATA_FINAL) {
		if (strcmp(client->url_buffer, "/v1/points") == 0) {
			if (client->method == HTTP_GET) {
				k_mutex_lock(&web_points_lock, K_FOREVER);
				int ret = points_json_encode(web_points, ARRAY_SIZE(web_points),
							     recv_buffer, sizeof(recv_buffer));
				k_mutex_unlock(&web_points_lock);
				if (ret != 0) {
					LOG_ERR("Error returning JSON points: %i", ret);
				}
			} else {
				// must be a post
				v1_payload_buf[cursor] = 0;
				// LOG_DBG("data: %s", v1_payload_buf);

				point pts[5] = {};
				int ret = points_json_decode(v1_payload_buf, cursor, pts,
							     ARRAY_SIZE(pts));

				if (ret < 0) {
					LOG_DBG("Post error decoding data: %i", ret);
					strcpy(recv_buffer, "{\"error\":\"error decoding data\"}");
				} else {
					LOG_DBG_POINTS("Received points", pts, ret);
					k_mutex_lock(&web_points_lock, K_FOREVER);
					for (int i = 0; i < ret; i++) {
						points_merge(web_points, ARRAY_SIZE(web_points),
							     &pts[i]);
						zbus_chan_pub(&point_chan, &pts[i], K_MSEC(500));
					}
					k_mutex_unlock(&web_points_lock);
				}
				strcpy(recv_buffer, "{\"error\":\"\"}");
			}
		} else {
			sprintf(recv_buffer, "%s", CONFIG_BOARD_TARGET);
		}

		resp->body = recv_buffer;
		resp->body_len = strlen(recv_buffer);
		resp->final_chunk = true;
		cursor = 0;
	}

	return 0;
}

struct http_resource_detail_dynamic v1_resource_detail = {
	.common =
		{
			.type = HTTP_RESOURCE_TYPE_DYNAMIC,
			.bitmask_of_supported_http_methods = BIT(HTTP_GET) | BIT(HTTP_POST),
		},
	.cb = v1_handler,
	.user_data = NULL,
};

HTTP_RESOURCE_DEFINE(points_resource, siot_http_service, "/v1/*", &v1_resource_detail);

ZBUS_MSG_SUBSCRIBER_DEFINE(web_sub);
ZBUS_CHAN_ADD_OBS(point_chan, web_sub, 3);

void web_thread(void *arg1, void *arg2, void *arg3)
{
	LOG_INF("siot web thread");
	http_server_start();

	point p = {};

	const struct zbus_channel *chan;
	while (!zbus_sub_wait_msg(&web_sub, &chan, &p, K_FOREVER)) {
		if (chan == &point_chan) {

			k_mutex_lock(&web_points_lock, K_FOREVER);
			int ret = points_merge(web_points, ARRAY_SIZE(web_points), &p);
			k_mutex_unlock(&web_points_lock);
			if (ret != 0) {
				LOG_ERR("Error storing point in web point cache: %i", ret);
			}
		}
	}
}

K_THREAD_DEFINE(web, STACKSIZE, web_thread, NULL, NULL, NULL, PRIORITY, K_ESSENTIAL, 0);
```
