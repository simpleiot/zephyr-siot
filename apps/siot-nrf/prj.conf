## CMakeLists.txt
```
# SPDX-License-Identifier: Apache-2.0

cmake_minimum_required(VERSION 3.20.0)
find_package(Zephyr REQUIRED HINTS $ENV{ZEPHYR_BASE})
project(siot-nrf)

target_sources(app PRIVATE src/main.c)
target_sources(app PRIVATE src/cloud/cloud.c)
```

## prj.conf
```kconfig
# Heap and stacks
CONFIG_HEAP_MEM_POOL_SIZE=8192
# cloud_publish() runs on the main thread and carries the HTTP client state and
# receive buffer on its stack. Measure with "kernel thread stacks" and trim once
# the publish path is proven.
CONFIG_MAIN_STACK_SIZE=8192
CONFIG_SYSTEM_WORKQUEUE_STACK_SIZE=2048

# Report per-thread stack usage via the "kernel thread stacks" shell command
CONFIG_THREAD_NAME=y
CONFIG_THREAD_STACK_INFO=y
CONFIG_INIT_STACKS=y

# New Libc
CONFIG_NEWLIB_LIBC=y
CONFIG_NEWLIB_LIBC_FLOAT_PRINTF=y

# Network
CONFIG_NETWORKING=y
CONFIG_NET_NATIVE=n
CONFIG_NET_SOCKETS=y
CONFIG_NET_SOCKETS_OFFLOAD=y
# POSIX_API replaces NET_SOCKETS_POSIX_NAMES (removed in Zephyr 4.x) and
# exposes unprefixed BSD socket names like connect/socket/getaddrinfo.
CONFIG_POSIX_API=y
CONFIG_NET_IPV6=n
CONFIG_NET_IPV4=y
CONFIG_NET_STATISTICS=y
# CONFIG_NET_ICMPV4=y
# CONFIG_NET_PKT=y
CONFIG_NET_CONFIG_SETTINGS=y
CONFIG_NET_CONFIG_NEED_IPV4=y 

# LTE link control
CONFIG_LTE_LINK_CONTROL=y
CONFIG_LTE_NETWORK_MODE_LTE_M_GPS=y

# PSM enablez (LTE_LC_PSM_MODULE gates the PSM submodule in NCS v3.x)
CONFIG_LTE_LC_PSM_MODULE=y
CONFIG_LTE_PSM_REQ=y
CONFIG_LTE_PSM_REQ_RPTAU="00100110" # 6 hour
CONFIG_LTE_PSM_REQ_RAT="00000011" # 6 sec active time

# Modem library
CONFIG_NRF_MODEM_LIB=y
CONFIG_NRF_MODEM_LIB_TRACE=n
CONFIG_MODEM_KEY_MGMT=y

# Date Time library
CONFIG_DATE_TIME=y

# Logging
CONFIG_LOG=y
# CONFIG_LOG_MODE_IMMEDIATE=y
# Deferred logging copies string arguments into this buffer. The default of 1024
# is too small for the HTTP response body, which is dropped rather than
# truncated when it does not fit.
CONFIG_LOG_BUFFER_SIZE=4096

# cJSON
CONFIG_CJSON_LIB=y

# HTTP
CONFIG_HTTP_CLIENT=y

# Debug
# CONFIG_ASSERT=y
# CONFIG_RESET_ON_FATAL_ERROR=n

# Cloud endpoint
#
# Defaults to postman-echo.com, a public request-echo service, so the publish
# path can be exercised without standing up a server. It echoes the request back
# as JSON, so a successful publish is visible in the device log. It also chains
# to ISRG Root X1, the CA provisioned to the modem in src/cloud/isrg-root-x1.pem.
#
# Point these at a real endpoint for anything beyond bring-up. Note the CA must
# match: a server with a certificate from a different root needs its own root
# swapped into isrg-root-x1.pem.
CONFIG_CLOUD_HOSTNAME="postman-echo.com"
CONFIG_CLOUD_PUBLISH_PATH="/post"
CONFIG_CLOUD_PORT=443

# Shell
CONFIG_SHELL=y
CONFIG_AT_SHELL=y
# The shell treats ? and * as glob characters, which strips the argument from
# AT read commands such as "at AT+CEREG?" before at_shell() sees it.
CONFIG_SHELL_WILDCARD=n
# CONFIG_NET_SHELL=y
```

## src/main.c
```c
/*
 * Copyright (c) 2020 Circuit Dojo LLC
 *
 * SPDX-License-Identifier: Apache-2.0
 */

#include <zephyr/kernel.h>
#include <zephyr/pm/device.h>
#include <zephyr/shell/shell.h>
#include <zephyr/logging/log.h>
LOG_MODULE_REGISTER(main);

/* nRF Libraries */
#include <modem/nrf_modem_lib.h>
#include <modem/lte_lc.h>
#include <modem/modem_info.h>

/* Local */
#include "cloud/cloud.h"

/* Timer */
static void timeout_handler(struct k_timer *timer_id);
K_TIMER_DEFINE(timer, timeout_handler, NULL);

/* Thread control */
K_SEM_DEFINE(thread_sem, 0, 1);

/* Variables */
static struct device_data data = {
	.do_something = true,
};

void cloud_cb(struct device_data *p_data)
{
	LOG_INF("Cloud callback");

	/* TODO: handle data here */
}

static void timeout_handler(struct k_timer *timer_id)
{
	LOG_INF("Timeout");
	k_sem_give(&thread_sem);
}

/* Publish runs on the main thread rather than the shell thread, which has a
 * much smaller stack than the TLS handshake and HTTP request need.
 */
static int cmd_publish(const struct shell *sh, size_t argc, char **argv)
{
	ARG_UNUSED(argc);
	ARG_UNUSED(argv);

	shell_print(sh, "Requesting publish");
	k_sem_give(&thread_sem);

	return 0;
}

SHELL_CMD_REGISTER(publish, NULL, "Publish device data to the cloud now", cmd_publish);

int main(void)
{
	int err;

	LOG_INF("HTTPS Sample. Board: %s", CONFIG_BOARD);

	/* Init modem lib */
	err = nrf_modem_lib_init();
	if (err < 0) {
		LOG_ERR("Failed to init modem lib. (err: %i)", err);
		return err;
	}

	/* Cloud init */
	err = cloud_init(cloud_cb);
	if (err < 0) {
		LOG_ERR("Unable to set callback. Err: %i", err);
		return err;
	}

	/* Power saving is turned on (lte_lc_init was removed in NCS v3.x —
	 * lte_lc_connect now performs initialization internally). */
	lte_lc_psm_req(true);

	/* Connect */
	err = lte_lc_connect();
	if (err < 0) {
		LOG_ERR("Failed to connect. Err: %i", err);
		return err;
	}

	/* Start timer */
	k_timer_start(&timer, K_MINUTES(CONFIG_DEFAULT_DELAY), K_MINUTES(CONFIG_DEFAULT_DELAY));

	/* Allow for instant publish */
	k_sem_give(&thread_sem);

	while (1) {
		k_sem_take(&thread_sem, K_FOREVER);

		/* Publish and sleep .. */
		err = cloud_publish(&data);
		if (err < 0) {
			LOG_ERR("Unable to publish. Err: %i", err);
		}
	}
}
```
