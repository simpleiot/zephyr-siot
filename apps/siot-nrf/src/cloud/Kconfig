## apps/siot-nrf/src/cloud/Kconfig
```kconfig
mainmenu "Application Cloud Configuration"

config CLOUD_TLS_SEC_TAG
    int "TLS Sec Tag"
    default 42

config CLOUD_HOSTNAME
    string "Base URL"
    default "postman-echo.com"
    help
      Host to publish to. The default is a public request-echo service, useful
      for bring-up. The host's certificate must chain to the CA provisioned to
      the modem (see src/cloud/isrg-root-x1.pem).

config CLOUD_PORT
    int "Port"
    default 443

config CLOUD_PUBLISH_PATH
    string "Publish Path"
    default "/post"
    help
      Path to POST to. "/post" is the echo endpoint on the default host.
```

## boards/esp32_poe/board.yml
```yaml
board:
  name: esp32_poe
  full_name: Olimex ESP32-POE
  vendor: olimex
  socs:
  - name: esp32
```

## boards/esp32_poe_wrover/board.yml
```yaml
board:
  name: esp32_poe_wrover
  full_name: Olimex ESP32-POE (WROVER module)
  vendor: olimex
  socs:
  - name: esp32
```

## boards/fysetc_ucan/board.yml
```yaml
board:
  name: fysetc_ucan
  full_name: FYSETC UCAN
  vendor: fysetc
  socs:
    - name: stm32f072xb
```

## lib/Kconfig
```kconfig
mainmenu "SIOT library"

config LIB_SIOT
	bool "Enable the JSON codec"
	select JSON_LIBRARY
	select THREAD_MONITOR
	select THREAD_RUNTIME_STATS
	select ZBUS
	select ZBUS_RUNTIME_OBSERVERS
	select ZBUS_MSG_SUBSCRIBER
	select FLASH
	select FLASH_PAGE_LAYOUT
	select ZMS

if LIB_SIOT

config SIOT_LOG_LEVEL
	int "Default log level for SIOT"
	default 4
	help
		The default log level, which is used to filter log messages.

		0: None
		1: Error
		2: Warn
		3: Info
		4: Debug
		5: Verbose

config SIOT_POINT_CACHE
	bool "Point cache"
	help
		Maintain a cache of the most recent value of every point
		published on zbus point_chan, updated by a subscriber thread.

		Gives any subsystem needing the whole current state one place
		to read it from, rather than tracking points itself.

if SIOT_POINT_CACHE

config SIOT_POINT_CACHE_SIZE
	int "Number of points the cache holds"
	default 40
	range 1 47
	help
		Must not exceed POINT_JS_ARRAY_MAX (47), since
		points_json_encode refuses to encode more points than that.

config SIOT_POINT_CACHE_THREAD_STACK
	int "Point cache thread stack size"
	default 2048

config SIOT_POINT_CACHE_THREAD_PRIO
	int "Point cache thread priority"
	default 7

config SIOT_POINT_SHELL
	bool "Point shell streaming"
	depends on SHELL
	help
		Register the `siot` shell command and allow points to be
		streamed to the console as they change, one ASCII line per
		point.

		This is what a host running Simple IoT consumes when a serial
		node is configured for the shell protocol, and it is readable
		by a developer watching the same console.

endif # SIOT_POINT_CACHE

endif #LIB_SIOT
```

## west.yml
```yaml
manifest:
  remotes:
    - name: simpleiot
      url-base: https://github.com/simpleiot
    - name: zephyrproject-rtos
      url-base: https://github.com/zephyrproject-rtos
  projects:
    - name: zephyr
      remote: zephyrproject-rtos
      revision: v4.4.0
      import:
        name-allowlist:
          - hal_espressif
          - hal_stm32
          - hal_rpi_pico
          - cmsis
          - cmsis_6
          - mbedtls
          - picolibc
          - fatfs
    - name: zephyr-snmp
      remote: simpleiot
      revision: main
      path: modules/lib/snmp
    - name: module-sample
      url: https://github.com/yashi/module-sample
      revision: main
      path: modules/lib/sample
    - name: west-debug-tools
      revision: main
      url: https://github.com/hasheddan/west-debug-tools
      west-commands: west-commands.yml
  self:
    path: siot
```
